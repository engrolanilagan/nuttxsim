## apps/examples/myapp/Kconfig
```kconfig
#
# For a description of the syntax of this configuration file,
# see the file kconfig-language.txt in the NuttX tools repository.
#

config EXAMPLES_MYAPP
	tristate "\"My first NuttX APP!\" example"
	default n
	---help---
		Enable the \"MYAPP\" example

if EXAMPLES_MYAPP
endif
```

## apps/zmq/asyncsrv/Kconfig
```kconfig
#
# For a description of the syntax of this configuration file,
# see the file kconfig-language.txt in the NuttX tools repository.
#

config ZMQ_ASYNCSRV
	tristate "\"CZMQ Asynchronous Server\" example"
	default n
	---help---
		Enable the CZMQ Asynchronous Server example

if ZMQ_ASYNCSRV
endif
```

## apps/zmq/libczmq/Kconfig
```kconfig
#
# For a description of the syntax of this configuration file,
# see the file kconfig-language.txt in the NuttX tools repository.
#

config ZMQ_LIBCZMQ
	tristate "\"CZMQ Library\""
	default n
	---help---
		Enable High Level C Bindig for ZeroMQ Library

if ZMQ_LIBZMQ
endif
```
